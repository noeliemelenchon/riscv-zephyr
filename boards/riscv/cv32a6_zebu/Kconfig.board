## boards/riscv/cv32a6_zebu/Kconfig.board
```kconfig
# SPDX-License-Identifier: Apache-2.0

config BOARD_CV32A6_ZEBU
	bool "CV32A6 Zebu target"
	depends on SOC_RISCV_C32VA6
```

## boards/riscv/cv32a6_zebu/Kconfig.defconfig
```kconfig
# SPDX-License-Identifier: Apache-2.0

config BOARD
	default "cv32a6_zebu"

config SYS_CLOCK_TICKS_PER_SEC
	default 128
```

## boards/riscv/cv32a6_zybo/Kconfig.board
```kconfig
# SPDX-License-Identifier: Apache-2.0

config BOARD_CV32A6_ZYBO
	bool "CV32A6 Zybo target"
	depends on SOC_RISCV_C32VA6
```

## boards/riscv/cv32a6_zybo/Kconfig.defconfig
```kconfig
# SPDX-License-Identifier: Apache-2.0

config BOARD
	default "cv32a6_zybo"

config SYS_CLOCK_TICKS_PER_SEC
	default 128
```

## boards/riscv/cv32a6_zybo/cv32a6_zybo_defconfig
```kconfig
# SPDX-License-Identifier: Apache-2.0

CONFIG_SOC_SERIES_RISCV_CVA6=y
CONFIG_SOC_RISCV_CV32A6=y
CONFIG_BOARD_CV32A6_ZYBO=y
CONFIG_CONSOLE=y
CONFIG_SERIAL=y
#CONFIG_UART_SIFIVE_PORT_0=y
CONFIG_UART_CONSOLE=y
CONFIG_XIP=n
```

## soc/riscv/riscv-privilege/cva6/Kconfig.series
```kconfig
# RISCV_CVA6 SOC implementation

# Copyright (c) 2022 Kevin Eyssartier <kevin.eyssartier@thalesgroup.com>
# SPDX-License-Identifier: Apache-2.0

config SOC_SERIES_RISCV_CVA6
	bool "CVA6 SOC implementation"
	select RISCV
	select SOC_FAMILY_RISCV_PRIVILEGE
	help
	  Enable support for CVA6 SOC
```

## soc/riscv/riscv-privilege/cva6/Kconfig.soc
```kconfig
# RISCV_CVA6 SOC implementation

# Copyright (c) 2022 Kevin Eyssartier <kevin.eyssartier@thalesgroup.com>
# SPDX-License-Identifier: Apache-2.0

choice
	prompt "CVA6 SOC implementation"
	depends on SOC_SERIES_RISCV_CVA6

config SOC_RISCV_CV32A6
	bool "CV32A6 SOC implementation"
	select INCLUDE_RESET_VECTOR
	select RISCV_ISA_RV32I
	select RISCV_ISA_EXT_M
	select RISCV_ISA_EXT_A
	select RISCV_ISA_EXT_ZICSR
	select RISCV_ISA_EXT_ZIFENCEI

config SOC_RISCV_CV64A6
	bool "CV64A6 SOC implementation"
	select ATOMIC_OPERATIONS_C
	select INCLUDE_RESET_VECTOR
	select 64BIT
	select RISCV_ISA_RV64I
	select RISCV_ISA_EXT_M
	select RISCV_ISA_EXT_A
	select RISCV_ISA_EXT_C
	select RISCV_ISA_EXT_ZICSR
	select RISCV_ISA_EXT_ZIFENCEI

endchoice
```
